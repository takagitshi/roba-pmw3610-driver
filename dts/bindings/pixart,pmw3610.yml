## dts/bindings/pixart,pmw3610.yml
```yaml
description: |
  Sensor driver for the pixart PMW3610 mouse sensor

compatible: "pixart,pmw3610"

include: spi-device.yaml

properties:
  irq-gpios:
    type: phandle-array
    required: true
  scroll-layers:
    type: array
    default: []
  snipe-layers:
    type: array
    default: []
  automouse-layer:
    type: int
    default: -1
  pointer-acceleration:
    type: boolean
    description: Enable same-frame pointer acceleration for this sensor instance
  pointer-acceleration-base-gain-milli:
    type: int
    default: 1000
    description: Low-speed gain in thousandths
  pointer-acceleration-takeoff-speed:
    type: int
    default: 16
    description: Normalized vector speed where the gain ramp starts
  pointer-acceleration-full-speed:
    type: int
    default: 80
    description: Normalized vector speed where the output-speed slope reaches maximum gain
  pointer-acceleration-max-gain-milli:
    type: int
    default: 2000
    description: Maximum output-speed slope and asymptotic multiplier in thousandths
  pointer-acceleration-reference-interval-ms:
    type: int
    default: 8
    description: Sensor report interval used to normalize delayed frames
  pointer-acceleration-idle-reset-ms:
    type: int
    default: 60
    description: Idle time that clears fractional remainder state
  pointer-acceleration-precision-mode:
    type: boolean
    description: Enable a lower fixed gain that smoothly rejoins the standard curve
  pointer-acceleration-precision-gain-milli:
    type: int
    default: 500
    description: Precision-region gain in thousandths
  pointer-acceleration-precision-speed:
    type: int
    default: 16
    description: Highest normalized vector speed that uses only the precision gain
  pointer-acceleration-precision-full-speed:
    type: int
    description: |
      Optional normalized vector speed at which the precision transition ends
      and the standard acceleration curve resumes. When omitted, this uses
      pointer-acceleration-takeoff-speed to preserve the original precision
      curve.
  pointer-acceleration-scroll-layer:
    type: int
    default: 2
    description: Layer on which acceleration is bypassed for raw scrolling
  pointer-acceleration-gesture-layer:
    type: int
    default: 3
    description: Layer on which acceleration is bypassed for raw gestures
  pointer-acceleration-gesture-layer-2:
    type: int
    description: |
      Optional second layer on which acceleration is bypassed for raw gestures.
      When omitted, it defaults to pointer-acceleration-gesture-layer.

child-binding:
  description: "Invoke behaviors when the track ball is moved on specific layers"
  properties:
    layers:
      description: "Layers on which the behavior will be invoked"
      type: array
      required: true
    bindings:
      description: "Behaviors to be invoked"
      type: phandle-array
      required: true
    tick:
      description: "Required ticks to trigger a ball action. Higher values require more movement to trigger a ball action. If omitted, CONFIG_PMW3610_BALL_ACTION_TICK will be used."
      type: int
    wait-ms:
      description: "Time to wait (in milliseconds) before triggering the next behavior binding. If omitted, it will be set to 0."
      type: int
    tap-ms:
      description: "Time to wait (in milliseconds) between the press and release events on a triggered behavior binding. If omitted, it will be set to 0."
      type: int
```
